## projects/ROCKNIX/devices/H700/packages/u-boot/sources/configs/anbernic_rg35xx_h700_auto_defconfig
```kconfig
CONFIG_ARM=y
CONFIG_ARCH_SUNXI=y
CONFIG_DEFAULT_DEVICE_TREE="allwinner/sun50i-h700-anbernic-rg35xx-2024"
CONFIG_SPL=y
CONFIG_MACH_SUN50I_H616=y
CONFIG_SUNXI_DRAM_H616_ANBERNIC=y
CONFIG_DRAM_SUNXI_PHY_ADDR_MAP_1=y
CONFIG_R_I2C_ENABLE=y
CONFIG_SPL_I2C=y
CONFIG_SPL_SYS_I2C_LEGACY=y
CONFIG_SYS_I2C_MVTWSI=y
CONFIG_SYS_I2C_SLAVE=0x7f
CONFIG_SYS_I2C_SPEED=400000
CONFIG_REGULATOR_AXP=y
CONFIG_AXP717_POWER=y
CONFIG_AXP_DISABLE_BOOT_ON_POWERON=y
CONFIG_AXP_DCDC2_VOLT=940
CONFIG_AXP_DCDC3_VOLT=1100
CONFIG_EFI_LOADER=n
CONFIG_BOOTDELAY=0
CONFIG_LED_STATUS=y
CONFIG_LED_STATUS_GPIO=y
CONFIG_LED_STATUS0=y
CONFIG_LED_STATUS_BIT=267
CONFIG_LED_STATUS_STATE=2
```
